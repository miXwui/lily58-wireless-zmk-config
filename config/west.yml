## config/west.yml
```yaml
manifest:
  remotes:
    - name: zmkfirmware
      url-base: https://github.com/zmkfirmware
    - name: urob
      url-base: https://github.com/urob
  projects:
    - name: zmk
      remote: zmkfirmware
      # Pin: Zephyr 4.1 + HWMv2 (nice_nano//zmk) (20260708)
      # - Issue: deep sleep battery drain
      #   https://github.com/zmkfirmware/zmk/issues/3207
      # - Feature: native Unicode; we're using urob/zmk-unicode
      #   https://github.com/zmkfirmware/zmk/issues/232
      revision: 904c9aec8822d79149d42c8a9a77e8828eb08f5a
      import: app/west.yml
    - name: zmk-unicode
      remote: urob
      revision: main
  self:
    path: config
```
